#include <Servo.h>
#include <ESC.h>


// ESCs
#define escL_pin 8
#define escR_pin 9
#define escM_pin 10

// Minimum & Maximum Rotation Speed for BLDC Motors
#define STOP_SPEED 1000
#define MIN_SPEED 1140
#define MAX_SPEED 1500


// Actual Thrust & Azimuth Angle
float thrust1;                  // Thrust generated by BLDC motor 1
float thrust2;
float thrust3;

// Pulse Width to be sent to BLDC Motors
float pulseWidth1;
float pulseWidth2;
float pulseWidth3;


// ESC Objects
ESC escL(escL_pin,1000,2000,500); // ESC_Name(PIN, Minimum Value, Maximum Value, Arm Value)
ESC escR(escR_pin,1000,2000,500);
ESC escM(escM_pin,1000,2000,500);


void setup() {
    Serial.begin(115200);
    Serial2.begin(115200);

    pinMode(escL_pin,OUTPUT);
    pinMode(escR_pin,OUTPUT);
    pinMode(escM_pin,OUTPUT);

    escL.arm();
    escR.arm();
    escM.arm();
    delay(15000);

    Serial.println("Setup DONE");
}


int i = 0;
int thrust1_vec[] = {1,0,0,0,1};
int thrust2_vec[] = {0,1,0,0,1};
int thrust3_vec[] = {0,0,1,0,1};

void loop() {
    if (Serial2.available() > 0) {
        Serial.println(Serial2.read());
//      char c = Serial2.read();            // read serial port from esp32
//      
//      if (c == 'S') {                     
//          if (Serial2.available() >= 8) {    
//              sp1 = Serial2.parseFloat();     // asign setpoint motor 1
//              sp2 = Serial2.parseFloat();     // asign setpoint motor 2
//          }
//      }
    }
  
//    delay(5000);
//
//    thrust1 = thrust1_vec[i%5];
//    thrust2 = thrust2_vec[i%5];
//    thrust3 = thrust3_vec[i%5];
//    i++;
//  
//    // Convert thrusts into commands
//    pulseWidth1 = thrust2command(thrust1);
//    pulseWidth2 = thrust2command(thrust2);
//    pulseWidth3 = thrust2command(thrust3);
//  
//    escL.speed(pulseWidth1);
//    escR.speed(pulseWidth2);
//    escM.speed(pulseWidth3);
//
//    Serial.println((String)pulseWidth1 + "\t" + pulseWidth2 + "\t" + pulseWidth3);
}


float thrust2command(float thrust) {
    float pulseWidth = ( thrust + 1.6266 ) / 0.0017;

    if ( pulseWidth < MIN_SPEED ) {
        pulseWidth = STOP_SPEED;
    }
    if ( pulseWidth > MAX_SPEED ) {
        pulseWidth = MAX_SPEED;
    }

    return pulseWidth;
}
